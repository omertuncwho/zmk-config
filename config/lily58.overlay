/ {
    chosen {
        zmk,display = &oled;
    };
};

&pro_micro_i2c {
    status = "okay";

    oled: sh1106@3c {
        compatible = "solomon,sh1106fb";
        reg = <0x3c>;

        width = <128>;
        height = <64>;

        multiplex-ratio = <63>;
        prechargep = <0x22>;
        segment-offset = <2>;
    };
};
